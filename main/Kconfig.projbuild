## main/Kconfig.projbuild
```kconfig
menu "SenseCAP Indicator"

    config INDICATOR_LORAWAN_ENABLED
        bool "Enable LoRaWAN (SX1262)"
        default n
        help
            Enable LoRaWAN support for D1L / D1Pro models with SX1262 radio.
            Uses RadioLib for LoRaWAN MAC (Class A / Class C).
            Disable for D1 / D1S models (no LoRa hardware).

    menu "LoRaWAN Configuration"
        depends on INDICATOR_LORAWAN_ENABLED

        choice LORAWAN_REGION
            prompt "LoRaWAN Region"
            default LORAWAN_REGION_EU868

            config LORAWAN_REGION_EU868
                bool "EU868"
            config LORAWAN_REGION_US915
                bool "US915"
            config LORAWAN_REGION_CN470
                bool "CN470"
            config LORAWAN_REGION_AS923
                bool "AS923"
            config LORAWAN_REGION_AU915
                bool "AU915"
        endchoice

        config LORAWAN_DEV_EUI
            string "Device EUI (16 hex chars)"
            default "0000000000000000"
            help
                8-byte Device EUI in hex. Obtain from your LoRaWAN network server.

        config LORAWAN_JOIN_EUI
            string "Join EUI / App EUI (16 hex chars)"
            default "0000000000000000"
            help
                8-byte Join EUI (formerly App EUI) in hex.

        config LORAWAN_APP_KEY
            string "Application Key (32 hex chars)"
            default "00000000000000000000000000000000"
            help
                16-byte Application Key in hex for OTAA.

        config LORAWAN_NWK_KEY
            string "Network Key (32 hex chars)"
            default "00000000000000000000000000000000"
            help
                16-byte Network Key in hex (LoRaWAN 1.1). Same as App Key for 1.0.x.

        choice LORAWAN_CLASS
            prompt "LoRaWAN Device Class"
            default LORAWAN_CLASS_C

            config LORAWAN_CLASS_A
                bool "Class A (lowest power)"
            config LORAWAN_CLASS_C
                bool "Class C (continuous RX)"
        endchoice

        config LORAWAN_SUBBAND
            int "Sub-band (0 = all, 1-8 for US915/AU915)"
            default 0
            range 0 8
            help
                Sub-band selection for US915 / AU915 regions.
                0 = use all channels. 1-8 = restrict to specific sub-band.

    endmenu

endmenu
```

## sdkconfig.defaults
```kconfig
CONFIG_IDF_TARGET="esp32s3"
CONFIG_IDF_EXPERIMENTAL_FEATURES=y

# PSRAM — 8MB Octal PSRAM on ESP32-S3-WROOM-1-N8R8
CONFIG_SPIRAM=y
CONFIG_SPIRAM_SPEED_80M=y
CONFIG_SPIRAM_MODE_OCT=y
CONFIG_SPIRAM_FETCH_INSTRUCTIONS=y
CONFIG_SPIRAM_RODATA=y

# Flash
CONFIG_ESPTOOLPY_FLASHMODE_QIO=y
CONFIG_ESPTOOLPY_FLASHFREQ_80M=y
CONFIG_ESPTOOLPY_FLASHSIZE_8MB=y

# CPU
CONFIG_ESP_DEFAULT_CPU_FREQ_MHZ_240=y
CONFIG_COMPILER_OPTIMIZATION_PERF=y

# Partitions
CONFIG_PARTITION_TABLE_CUSTOM=y
CONFIG_PARTITION_TABLE_CUSTOM_FILENAME="partitions.csv"
CONFIG_PARTITION_TABLE_FILENAME="partitions.csv"
CONFIG_PARTITION_TABLE_OFFSET=0x8000

# FreeRTOS
CONFIG_FREERTOS_HZ=1000

# LVGL
CONFIG_LV_TXT_ENC_UTF8=y
CONFIG_LV_FONT_DEFAULT_MONTSERRAT_20=y
CONFIG_LV_FONT_MONTSERRAT_14=y
CONFIG_LV_FONT_MONTSERRAT_20=y
CONFIG_LV_FONT_MONTSERRAT_32=y

# Bluetooth / BLE / NimBLE
CONFIG_BT_ENABLED=y
CONFIG_BT_NIMBLE_ENABLED=y
CONFIG_BT_NIMBLE_MAX_CONNECTIONS=1
CONFIG_BT_NIMBLE_HOST_TASK_STACK_SIZE=5120
CONFIG_BT_NIMBLE_TASK_STACK_SIZE=5120
CONFIG_BT_NIMBLE_MEM_ALLOC_MODE_EXTERNAL=y
CONFIG_BT_CTRL_BLE_MAX_ACT=10
CONFIG_BT_CTRL_BLE_STATIC_ACL_TX_BUF_NB=0
CONFIG_BT_CTRL_BLE_HOST_FLOW_CTRL=y
CONFIG_BT_CTRL_BLE_HOST_FLOW_CTRL_EFF=y
CONFIG_BT_CTRL_BLE_MAX_ACT_EFF=10

# LoRaWAN (disabled by default — enable via menuconfig for D1L/D1Pro)
# CONFIG_INDICATOR_LORAWAN_ENABLED is not set
```
